#include "oled.h"
#include <string.h>
#include <stdio.h>

/* ============================================================
 *  oled.c —— SSD1306 128x64 SPI 驱动（移植自 F407 参考工程 danxiangnibian）
 *  移植改动：头文件 main.h(G4)；去掉逆变专用 BoostUI/BoostCalUI；
 *  引脚宏与 SPI3 不变（PC10/PC12/PC11/PD1/PD0 在 G4 上同名可用）
 * ============================================================ */

#ifndef OLED_WIDTH
#define OLED_WIDTH   128
#endif
#ifndef OLED_HEIGHT
#define OLED_HEIGHT   64
#endif
#ifndef OLED_PAGES
#define OLED_PAGES   (OLED_HEIGHT / 8)
#endif

/* ---------- 显存缓冲 ---------- */
static uint8_t oled_buf[OLED_PAGES][OLED_WIDTH];

/* ============================================================
 *  字库 8x16 ASCII (32..'Z')，未用字符以空格兜底
 * ============================================================ */
static const uint8_t Font8x16[][16] = {
    {0x00,0x00,0x00,0x00,0x00,0x00,0x00,0x00,0x00,0x00,0x00,0x00,0x00,0x00,0x00,0x00}, /* ' ' */
    {0x00,0x00,0x00,0xF8,0x00,0x00,0x00,0x00,0x00,0x00,0x00,0x33,0x30,0x00,0x00,0x00}, /* '!' */
    {0x00,0x10,0x0C,0x06,0x10,0x0C,0x06,0x00,0x00,0x00,0x00,0x00,0x00,0x00,0x00,0x00}, /* '"' */
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    {0x10,0x08,0x08,0xC8,0x38,0x08,0x00,0x00,0x20,0x38,0x26,0x21,0x20,0x30,0x28,0x00}, /* 'Z' */
};

/* ============================================================
 *  底层 SPI 写
 * ============================================================ */
static HAL_StatusTypeDef OLED_SPI_Send(const uint8_t *data, uint16_t size)
{
    return HAL_SPI_Transmit(&hspi2, (uint8_t *)data, size, 1000U);
}

static void OLED_WriteByte(uint8_t dat, uint8_t cmd)
{
    if (cmd) OLED_DC_Set();
    else     OLED_DC_Clr();

    OLED_CS_Clr();
    (void)OLED_SPI_Send(&dat, 1);
    OLED_CS_Set();
    OLED_DC_Set();
}

static void OLED_WriteCmd(uint8_t cmd)  { OLED_WriteByte(cmd, 0); }

/* ============================================================
 *  OLED_Init —— SSD1306 初始化序列
 * ============================================================ */
void OLED_Init(void)
{
    OLED_RES_Clr();
    HAL_Delay(100);
    OLED_RES_Set();
    HAL_Delay(100);

    OLED_WriteCmd(0xAE); /* 关显示 */
    OLED_WriteCmd(0xD5); OLED_WriteCmd(0x80); /* 时钟分频 */
    OLED_WriteCmd(0xA8); OLED_WriteCmd(0x3F); /* Mux ratio 63 */
    OLED_WriteCmd(0xD3); OLED_WriteCmd(0x00); /* 显示偏移 0 */
    OLED_WriteCmd(0x40);                       /* 起始行 0 */
    OLED_WriteCmd(0x8D); OLED_WriteCmd(0x14); /* 电荷泵使能 */
    OLED_WriteCmd(0x20); OLED_WriteCmd(0x02); /* 页寻址模式 */
    OLED_WriteCmd(0xA1);                       /* 段重映射 */
    OLED_WriteCmd(0xC8);                       /* COM 扫描方向 */
    OLED_WriteCmd(0xDA); OLED_WriteCmd(0x12); /* COM 引脚配置 */
    OLED_WriteCmd(0x81); OLED_WriteCmd(0xCF); /* 对比度 */
    OLED_WriteCmd(0xD9); OLED_WriteCmd(0xF1); /* 预充电周期 */
    OLED_WriteCmd(0xDB); OLED_WriteCmd(0x40); /* VCOMH */
    OLED_WriteCmd(0xA4);                       /* 全亮恢复 */
    OLED_WriteCmd(0xA6);                       /* 正常显示 */
    OLED_WriteCmd(0xAF);                       /* 开显示 */

    OLED_Clear();
    OLED_Refresh();
}

/* ============================================================
 *  OLED_Clear / OLED_Refresh
 * ============================================================ */
void OLED_Clear(void)
{
    memset(oled_buf, 0, sizeof(oled_buf));
}

void OLED_Refresh(void)
{
    for (uint8_t page = 0; page < OLED_PAGES; page++) {
        OLED_WriteCmd(0xB0 + page);
        OLED_WriteCmd(0x00);
        OLED_WriteCmd(0x10);
        OLED_DC_Set();
        OLED_CS_Clr();
        (void)OLED_SPI_Send(oled_buf[page], OLED_WIDTH);
        OLED_CS_Set();
    }
}

/* ============================================================
 *  OLED_DrawPoint
 * ============================================================ */
void OLED_DrawPoint(uint8_t x, uint8_t y, uint8_t color)
{
    if (x >= OLED_WIDTH || y >= OLED_HEIGHT) return;
    if (color)
        oled_buf[y / 8][x] |=  (1 << (y % 8));
    else
        oled_buf[y / 8][x] &= ~(1 << (y % 8));
}

/* ============================================================
 *  OLED_ShowChar (8x16)
 * ============================================================ */
void OLED_ShowChar(uint8_t x, uint8_t y, char ch, uint8_t size)
{
    (void)size;
    if (ch < ' ' || ch > 'Z') ch = ' ';
    uint8_t idx = ch - ' ';

    for (uint8_t i = 0; i < 8; i++) {
        uint8_t col_top = Font8x16[idx][i];
        uint8_t col_bot = Font8x16[idx][i + 8];
        for (uint8_t bit = 0; bit < 8; bit++) {
            OLED_DrawPoint(x + i, y + bit,     (col_top >> bit) & 0x01);
            OLED_DrawPoint(x + i, y + bit + 8, (col_bot >> bit) & 0x01);
        }
    }
}

void OLED_ShowString(uint8_t x, uint8_t y, const char *str, uint8_t size)
{
    while (*str) {
        OLED_ShowChar(x, y, *str++, size);
        x += 8;
        if (x + 8 > OLED_WIDTH) { x = 0; y += 16; }
    }
}

/* ============================================================
 *  OLED_ShowFloat / OLED_ShowInt
 * ============================================================ */
void OLED_ShowFloat(uint8_t x, uint8_t y, float val, uint8_t decimals, uint8_t size)
{
    char buf[16];
    if (decimals == 1)      snprintf(buf, sizeof(buf), "%.1f", (double)val);
    else if (decimals == 2) snprintf(buf, sizeof(buf), "%.2f", (double)val);
    else if (decimals == 4) snprintf(buf, sizeof(buf), "%.4f", (double)val);
    else                    snprintf(buf, sizeof(buf), "%.0f", (double)val);
    OLED_ShowString(x, y, buf, size);
}

void OLED_ShowInt(uint8_t x, uint8_t y, int32_t val, uint8_t size)
{
    char buf[12];
    snprintf(buf, sizeof(buf), "%ld", (long)val);
    OLED_ShowString(x, y, buf, size);
}

/* ============================================================
 *  OLED_DrawLine (Bresenham)
 * ============================================================ */
void OLED_DrawLine(uint8_t x0, uint8_t y0, uint8_t x1, uint8_t y1)
{
    int16_t dx = (int16_t)x1 - x0, dy = (int16_t)y1 - y0;
    int16_t sx = dx > 0 ? 1 : -1, sy = dy > 0 ? 1 : -1;
    if (dx < 0) dx = -dx;
    if (dy < 0) dy = -dy;
    int16_t err = dx - dy;
    int16_t cx = x0, cy = y0;
    while (1) {
        OLED_DrawPoint((uint8_t)cx, (uint8_t)cy, 1);
        if (cx == x1 && cy == y1) break;
        int16_t e2 = 2 * err;
        if (e2 > -dy) { err -= dy; cx += sx; }
        if (e2 <  dx) { err += dx; cy += sy; }
    }
}

/* ============================================================
 *  OLED_DrawRect
 * ============================================================ */
void OLED_DrawRect(uint8_t x, uint8_t y, uint8_t w, uint8_t h, uint8_t fill)
{
    if (fill) {
        for (uint8_t j = y; j < y + h && j < OLED_HEIGHT; j++)
            for (uint8_t i = x; i < x + w && i < OLED_WIDTH; i++)
                OLED_DrawPoint(i, j, 1);
    } else {
        OLED_DrawLine(x,       y,       x+w-1, y      );
        OLED_DrawLine(x,       y+h-1,   x+w-1, y+h-1  );
        OLED_DrawLine(x,       y,       x,     y+h-1  );
        OLED_DrawLine(x+w-1,   y,       x+w-1, y+h-1  );
    }
}
